## src/examples/my_app/Kconfig
```kconfig
menuconfig EXAMPLES_MY_APP
	bool "my_app"
	default n
	---help---
		Enable support for my_app
```

## src/examples/my_intrusivequeue/Kconfig
```kconfig
menuconfig EXAMPLES_my_intrusivequeue
	bool "my_intrusivequeue"
	default n
	---help---
		Enable support for my_intrusivequeue
```

## src/examples/my_status_hello/Kconfig
```kconfig
menuconfig EXAMPLES_my_status_hello
	bool "my_status_hello"
	default n
	---help---
		Enable support for my_status_hello
```

## src/examples/my_uorb_test/Kconfig
```kconfig
menuconfig EXAMPLES_my_uorb_test
	bool "my_uorb_test"
	default n
	---help---
		Enable support for my_uorb_test
```
